## config/west.yml
```yaml
manifest:
  remotes:
    - name: zmkfirmware
      url-base: https://github.com/zmkfirmware
    - name: edtoaster
      url-base: https://github.com/edtoaster
  projects:
    - name: zmk
      remote: zmkfirmware
      revision: main
      import: app/west.yml
    - name: zmk-module-toastview
      remote: edtoaster
      revision: main
  self:
    path: config
```
